## boards/arm/dongle/Kconfig.board
```kconfig
# nRF52840 Dongle NRF52840 board configuration

# Copyright (c) 2018 Nordic Semiconductor ASA
# SPDX-License-Identifier: Apache-2.0

config BOARD_DONGLE
	bool "nRF52840 DONGLE NRF52840 (customized)"
	depends on SOC_NRF52840_QIAA
```
